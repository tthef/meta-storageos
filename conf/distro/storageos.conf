## conf/distro/storageos.conf
```bitbake
require conf/distro/poky.conf

DISTRO = "storageos"
DISTRO_NAME = "StorageOS (Virtual Storage Array)"
DISTRO_VERSION = "1.0.0"

# From http://marvel.com/comics/characters
DISTRO_CODENAME = "Apocalypse"

MAINTAINER = "Simon Croome <simon.croome@storageos.com>"

TARGET_VENDOR = "-storageos"

LOCALCONF_VERSION = "1"
PREFERRED_VERSION_linux-storageos ?= "3.19%"

DISTRO_FEATURES_DEFAULT ?= "systemd dhcp-client"
DISTRO_FEATURES ?= "${DISTRO_FEATURES_DEFAULT} ${DISTRO_FEATURES_LIBC}"


VIRTUAL-RUNTIME_init_manager = "systemd"
DISTRO_FEATURES_BACKFILL_CONSIDERED = "sysvinit"
VIRTUAL-RUNTIME_initscripts = ""

DISTRO_EXTRA_RDEPENDS += "kernel-module-xt-cgroup"
DISTRO_EXTRA_RDEPENDS += "kernel-module-iptable-nat"
DISTRO_EXTRA_RDEPENDS += "kernel-module-xt-addrtype"
DISTRO_EXTRA_RDEPENDS += "kernel-module-overlay"

#
# Kernel image features
#
# The INITRAMFS_IMAGE image variable will cause an additional recipe to
# be built as a dependency to the what ever rootfs recipe you might be
# using such as core-image-sato.  The initramfs might be needed for
# the initial boot of of the target system such as to load kernel
# modules prior to mounting the root file system.
#
# INITRAMFS_IMAGE_BUNDLE variable controls if the image recipe
# specified by the INITRAMFS_IMAGE will be run through an extra pass
# through the kernel compilation in order to build a single binary
# which contains both the kernel image and the initramfs.  The
# combined binary will be deposited into the tmp/deploy directory.
# NOTE: You can set INITRAMFS_IMAGE in an image recipe, but
#       INITRAMFS_IMAGE_BUNDLE can only be set in a conf file.
#
INITRAMFS_IMAGE_BUNDLE = "1"
```

## conf/layer.conf
```bitbake
# We have a conf and classes directory, add to BBPATH
BBPATH .= ":${LAYERDIR}"

# We have recipes-* directories, add to BBFILES
BBFILES += "${LAYERDIR}/recipes-*/*/*.bb \
	${LAYERDIR}/recipes-*/*/*.bbappend"

BBFILE_COLLECTIONS += "storageos"
BBFILE_PATTERN_storageos = "^${LAYERDIR}/"
# meta-virtualization is 8, we want to have higher priority, so that
# that our recipes get used
BBFILE_PRIORITY_storageos = "10"

LAYERDEPENDS_storageos = "core"
LAYERDEPENDS_storageos += "security"

IMAGE_INSTALL_append = " dhcp-client"
IMAGE_INSTALL_append = " libseccomp"
IMAGE_INSTALL_append = " docker"
```
